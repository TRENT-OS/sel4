/*
 * Copyright 2020, Data61, CSIRO (ABN 41 687 119 230)
 * Copyright (C) 2021, Hensoldt Cyber GmbH
 *
 * SPDX-License-Identifier: GPL-2.0-only
 */

/ {
	chosen {
		seL4,elfloader-devices =
		    "serial1";

		seL4,kernel-devices =
		    "serial1",
		    &{/soc/interrupt-controller@40041000},
		    &{/soc/local_intc@40000000},
		    &{/timer};
	};

	memory@0 {
		/* NOTE The Pi 4 can have {1,2,4}GB of RAM. During typical (e.g.
		 * Raspbian) boot, the GPU bootloader sets this property. This
		 * value was observed from within Raspbian on a 4GB Pi (from
		 * /proc/dev/ice-tree/memory and /proc/iomem).
		 */

		reg = < 0x0        0x0 0x3b400000
		        0x0 0x40000000 0xbc000000 >;

	};
};
